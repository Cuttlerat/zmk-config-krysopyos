## boards/shields/cosmorat/Kconfig.defconfig
```kconfig
if SHIELD_KRYSOPYOS_RIGHT
    config SPI
        default y
    config ZMK_POINTING
        default y
endif

if SHIELD_KRYSOPYOS_LEFT
    config ZMK_SPLIT_ROLE_CENTRAL
        default y
    config ZMK_POINTING
        default y
endif
```

## boards/shields/cosmorat/Kconfig.shield
```kconfig
config SHIELD_KRYSOPYOS_LEFT
	def_bool $(shields_list_contains,krysopyos_left)

config SHIELD_KRYSOPYOS_RIGHT
	def_bool $(shields_list_contains,krysopyos_right)

config SHIELD_KRYSOPYOS_DONGLE
	def_bool $(shields_list_contains,krysopyos_dongle)
```
